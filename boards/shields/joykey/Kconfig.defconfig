## boards/shields/joykey/Kconfig.defconfig
```kconfig
if SHIELD_JOYKEY

config ZMK_KEYBOARD_NAME
    default "JoyKey"

endif # SHIELD_JOYKEY
```

## config/west.yml
```yaml
manifest:
  defaults:
    revision: v0.2
  remotes:
    - name: zmkfirmware
      url-base: https://github.com/zmkfirmware
    - name: zmk-driver-encoder-matrix
      url-base: https://github.com/techy-robot/zmk-driver-encoder-matrix
  projects:
    - name: zmk
      remote: zmkfirmware
      import: app/west.yml
    - name: encoder-matrix
      remote: zmk-driver-encoder-matrix
      revision: main
  self:
    path: config
```
